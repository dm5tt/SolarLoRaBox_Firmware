## CMakeLists.txt
```
#-------------------------------------------------------------------------------
# Zephyr Example Application
#
# Copyright (c) 2021 Nordic Semiconductor ASA
# SPDX-License-Identifier: Apache-2.0

cmake_minimum_required(VERSION 3.20.0)
find_package(Zephyr REQUIRED HINTS $ENV{ZEPHYR_BASE})

project(app LANGUAGES C)
target_sources(app PRIVATE src/main.c src/lorawan_impl.c)
target_include_directories(app PRIVATE src)
```

## prj.conf
```kconfig
# Copyright (c) 2021 Nordic Semiconductor ASA
# SPDX-License-Identifier: Apache-2.0
#
# This file contains selected Kconfig options for the application.
CONFIG_LOG=y

CONFIG_LORA=y
CONFIG_LORA_SX126X=y
# CONFIG_LORA_LOG_LEVEL_DBG=y

CONFIG_LORAWAN=y
# CONFIG_LORAWAN_LOG_LEVEL_DBG=y
CONFIG_LORAMAC_REGION_EU868=y

CONFIG_MAIN_STACK_SIZE=2048
CONFIG_SYSTEM_WORKQUEUE_STACK_SIZE=2048


CONFIG_ADC=y
CONFIG_ADC_STM32=y
CONFIG_ADC_ASYNC=y
```

## debug.conf
```kconfig
# Copyright (c) 2021 Nordic Semiconductor ASA
# SPDX-License-Identifier: Apache-2.0
#
# This is a Kconfig fragment which can be used to enable debug-related options
# in the application. See the README for more details.

# compiler
CONFIG_DEBUG_OPTIMIZATIONS=y

# logging
CONFIG_APP_LOG_LEVEL_DBG=y
```

## src/main.c
```c
#include <zephyr/device.h>
#include <zephyr/lorawan/lorawan.h>
#include <zephyr/kernel.h>
#include <zephyr/drivers/adc.h>
#include <zephyr/pm/pm.h>
#include <zephyr/logging/log.h>

#include "lorawan_impl.h"

#define LOG_LEVEL CONFIG_LOG_DEBUG_LEVEL
LOG_MODULE_REGISTER(lorawan_sensor_device);

#define ADC_RESOLUTION 12
#define ADC_CHANNEL_COUNT 2
#define LORAWAN_JOIN_ATTEMPTS 10
#define RETRY_DELAY K_MINUTES(1)
#define SEND_INTERVAL K_MINUTES(25)

static uint16_t sample_buffer[ADC_CHANNEL_COUNT];

/* ADC Configuration */
static const struct adc_channel_cfg channel_cfg[] = {
    {
        .channel_id = 6, // ADC1_IN6 (PA2)
        .gain = ADC_GAIN_1,
        .reference = ADC_REF_INTERNAL,
        .acquisition_time = ADC_ACQ_TIME(ADC_ACQ_TIME_TICKS, 40),
    },
    {
        .channel_id = 7, // ADC1_IN7 (PA3)
        .gain = ADC_GAIN_1,
        .reference = ADC_REF_INTERNAL,
        .acquisition_time = ADC_ACQ_TIME(ADC_ACQ_TIME_TICKS, 40),
    }
};

static struct adc_sequence sequence = {
    .buffer = sample_buffer,
    .buffer_size = sizeof(sample_buffer),
    .resolution = ADC_RESOLUTION,
    .channels = BIT(6) | BIT(7)
};

static int configure_adc(const struct device *adc_dev)
{
    if (!device_is_ready(adc_dev)) {
        LOG_ERR("ADC device not ready");
        return -1;
    }

    for (int i = 0; i < ADC_CHANNEL_COUNT; i++) {
        if (adc_channel_setup(adc_dev, &channel_cfg[i]) < 0) {
            LOG_ERR("Failed to configure ADC channel %d", i);
            return -1;
        }
    }
    return 0;
}

static int join_lorawan(const struct device *lora_dev)
{
    struct lorawan_join_config join_cfg = {
        .mode = LORAWAN_ACT_OTAA,
        .dev_eui = (uint8_t *)LORAWAN_IMPL_DEV_EUI,
        .otaa = {
            .join_eui = (uint8_t *)LORAWAN_IMPL_JOIN_EUI,
            .app_key = (uint8_t *)LORAWAN_IMPL_APP_KEY,
            .nwk_key = (uint8_t *)LORAWAN_IMPL_APP_KEY,
            .dev_nonce = 12345
        }
    };

    LOG_INF("Joining network over OTAA");
    for (int attempts = 0; attempts < LORAWAN_JOIN_ATTEMPTS; attempts++) {
        int ret = lorawan_join(&join_cfg);
        if (ret == 0) {
            return 0;
        }
        LOG_ERR("LoRaWAN join failed: %d - Retrying", ret);
        k_sleep(RETRY_DELAY);
    }
    LOG_ERR("LoRaWAN join failed after multiple attempts.");
    return -1;
}

int main(void)
{
    const struct device *lora_dev = DEVICE_DT_GET(DT_ALIAS(lora0));
    lorawan_impl_init(lora_dev);

    if (join_lorawan(lora_dev) < 0) {
        return -1;
    }

    const struct device *adc_dev = DEVICE_DT_GET(DT_ALIAS(adc));
    if (configure_adc(adc_dev) < 0) {
        return -1;
    }

    while (1) {
        if (adc_read(adc_dev, &sequence) < 0) {
            LOG_ERR("ADC read failed");
            return -1;
        }

        for (int i = 0; i < ADC_CHANNEL_COUNT; i++) {
            LOG_INF("ADC[%d] = %d", i, sample_buffer[i]);
        }

        int ret = lorawan_send(2, (uint8_t *)sample_buffer, sizeof(sample_buffer), LORAWAN_MSG_UNCONFIRMED);
        if (ret < 0) {
            LOG_ERR("LoRa send failed: %d", ret);
        } else {
            LOG_INF("LoRa message sent");
        }
        
        k_sleep(SEND_INTERVAL);
    }
}
```

## src/lorawan_impl.c
```c
#include "lorawan_impl.h"

#define LOG_LEVEL CONFIG_LOG_DEFAULT_LEVEL
#include <zephyr/logging/log.h>
LOG_MODULE_REGISTER(lorawan_impl);

void lorawan_impl_dl_callback(uint8_t port, uint8_t flags, int16_t rssi, int8_t snr, uint8_t len,
			const uint8_t *hex_data)
{
	LOG_INF("Port %d, Pending %d, RSSI %ddB, SNR %ddBm, Time %d", port,
		flags & LORAWAN_DATA_PENDING, rssi, snr, !!(flags & LORAWAN_TIME_UPDATED));
	if (hex_data) {
		LOG_HEXDUMP_INF(hex_data, len, "Payload: ");
	}
}

void lorawan_impl_datarate_changed(enum lorawan_datarate dr)
{
	uint8_t unused, max_size;

	lorawan_get_payload_sizes(&unused, &max_size);
	LOG_INF("New Datarate: DR_%d, Max Payload %d", dr, max_size);
}

int lorawan_impl_init(const struct device *lora_dev) {
	int ret;

	struct lorawan_downlink_cb downlink_cb = {
		.port = LW_RECV_PORT_ANY,
		.cb = lorawan_impl_dl_callback
	};

	lora_dev = DEVICE_DT_GET(DT_ALIAS(lora0));
	if (!device_is_ready(lora_dev)) {
		LOG_ERR("%s: device not ready.", lora_dev->name);
		return 0;
	}

	/* If more than one region Kconfig is selected, app should set region
	 * before calling lorawan_start()
	 */
	ret = lorawan_set_region(LORAWAN_REGION_EU868);
	if (ret < 0) {
		LOG_ERR("lorawan_set_region failed: %d", ret);
		return 0;
	}

	ret = lorawan_start();
	if (ret < 0) {
		LOG_ERR("lorawan_start failed: %d", ret);
		return 0;
	}

	lorawan_enable_adr(true);

	lorawan_register_downlink_callback(&downlink_cb);
	lorawan_register_dr_changed_callback(lorawan_impl_datarate_changed);

	return 0;
}
```

## src/lorawan_impl.h
```c
#ifndef LORAWAN_IMPL_H
#define LORAWAN_IMPL_H


#include <zephyr/kernel.h>
#include <zephyr/lorawan/lorawan.h>

#define LORAWAN_IMPL_DEV_EUI			{ 0x00 }  /* MSB! Dummy Key - doesn't work! */
#define LORAWAN_IMPL_JOIN_EUI	  	{ 0x00 }  /* MSB!  Dummy Key - doesn't work! */
#define LORAWAN_IMPL_APP_KEY			{ 0x00 } /* MSB!  Dummy Key - doesn't work! */

int lorawan_impl_init(const struct device *lora_dev);

#endif
```
