## boards/vendor/solarlorabox/board.yml
```yaml
board:
  name: solarlorabox 
  full_name: solarlorabox 
  vendor: dm5tt 
  socs:
    - name: stm32u083xx
```

## west.yml
```yaml
# Copyright (c) 2021 Nordic Semiconductor ASA
# SPDX-License-Identifier: Apache-2.0

manifest:
  defaults:
    remote: zephyrproject-rtos

  self:
    west-commands: scripts/west-commands.yml

  remotes:
    - name: zephyrproject-rtos
      url-base: https://github.com/zephyrproject-rtos

  projects:
    - name: zephyr
      remote: zephyrproject-rtos
      revision: main
      import:
        # By using name-allowlist we can clone only the modules that are
        # strictly needed by the application.
        name-allowlist:
          - cmsis      # required by the ARM port
          - hal_stm32  # required by the nucleo_f302r8 board (STM32 based)
    - name: loramac-node
      revision: fb00b383072518c918e2258b0916c996f2d4eebe
      path: modules/lib/loramac-node
```
